## platform/twatch/sdkconfig.defaults
```kconfig
# sdkconfig.defaults — T-Watch 2020 V3
#
# These values are merged into sdkconfig by `idf.py build` so you don't have
# to run menuconfig by hand.  Override anything here by running
# `idf.py menuconfig` after the first build.

# ── Target chip ─────────────────────────────────────────────────────────────
CONFIG_IDF_TARGET="esp32"

# ── Flash ────────────────────────────────────────────────────────────────────
# T-Watch has 16 MB flash; use QIO for maximum throughput
CONFIG_ESPTOOLPY_FLASHSIZE_16MB=y
CONFIG_ESPTOOLPY_FLASHMODE_QIO=y
CONFIG_ESPTOOLPY_FLASHFREQ_80M=y

# Partition table: single large app, no OTA
CONFIG_PARTITION_TABLE_SINGLE_APP=y

# ── PSRAM ────────────────────────────────────────────────────────────────────
# T-Watch has 8 MB PSRAM (SPIRAM).  Enable it so heap allocations can spill
# into it.  For this demo we don't use PSRAM explicitly but it's good practice
# to have it available.
CONFIG_ESP32_SPIRAM_SUPPORT=y
CONFIG_SPIRAM_MODE_QUAD=y
CONFIG_SPIRAM_SPEED_80M=y
CONFIG_SPIRAM_BOOT_INIT=y
CONFIG_SPIRAM_USE_MALLOC=y

# ── CPU clock ────────────────────────────────────────────────────────────────
CONFIG_ESP32_DEFAULT_CPU_FREQ_240=y

# ── Logging ──────────────────────────────────────────────────────────────────
CONFIG_LOG_DEFAULT_LEVEL_INFO=y
CONFIG_LOG_COLORS=y

# ── FreeRTOS ─────────────────────────────────────────────────────────────────
CONFIG_FREERTOS_HZ=1000
CONFIG_ESP_MAIN_TASK_STACK_SIZE=20480

# ── esp_lcd ──────────────────────────────────────────────────────────────────
# The ST7789 panel driver is part of esp_lcd which ships with IDF >= 5.0.
# No extra Kconfig needed; it's enabled automatically by the component dep.

# ── Floating point / math ────────────────────────────────────────────────────
# i2s_audio.c uses sinf() from libm; it's linked automatically by GCC but
# worth confirming the FPU is enabled (ESP32 has hardware FPU).
CONFIG_COMPILER_OPTIMIZATION_PERF=y

# ── SPI ─────────────────────────────────────────────────────────────────────
# Allow DMA transfers (required for large pixel bursts)
CONFIG_SPI_MASTER_IN_IRAM=y

# ── Bluetooth ───────────────────────────────────────────────────────────────
CONFIG_BT_ENABLED=y
CONFIG_BT_NIMBLE_ENABLED=y
CONFIG_BT_NIMBLE_SVC_GAP_APPEARANCE=y
CONFIG_BT_NIMBLE_NVS_PERSIST=y
```
